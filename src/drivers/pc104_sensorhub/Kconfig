## src/drivers/pc104_sensorhub/Kconfig
```kconfig
menuconfig DRIVERS_PC104_SENSORHUB
        bool "pc104 sensor hub"
        default n
        ---help---
                Enable support for the PC104 serial sensor hub that provides fused orientation and GPS data.
```

## src/drivers/pc104_serial_servo/Kconfig
```kconfig
menuconfig DRIVERS_PC104_SERIAL_SERVO
        bool "pc104 serial servo"
        default n
        ---help---
                Enable support for the PC104 serial servo output driver.
```
